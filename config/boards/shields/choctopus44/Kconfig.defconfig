## config/boards/shields/choctopus44/Kconfig.defconfig
```kconfig
if SHIELD_CHOCTOPUS44

config ZMK_KEYBOARD_NAME
    default "Choctopus44"

endif
```

## config/boards/shields/hillside48/Kconfig.shield
```kconfig
config SHIELD_HILLSIDE48_LEFT
    def_bool $(shields_list_contains,hillside48_left)

config SHIELD_HILLSIDE48_RIGHT
    def_bool $(shields_list_contains,hillside48_right)
```
